## ext_components/SmoothUI/Kconfig
```kconfig
menuconfig SMOOTH_UI_COMPONENT_ENABLED
    bool "Smooth UI Toolkit"
    default n
    help
        Enable the Smooth UI Toolkit component.
```

## ext_components/Spdlog/Kconfig
```kconfig
menuconfig SPDLOG_COMPONENT_ENABLED
    bool "Enable spdlog"
    default n
    help
        Enable the spdlog logging library component.
```

## ext_components/bluectl/Kconfig
```kconfig
menuconfig BLUECTL_COMPONENT_ENABLED
    bool "Enable bluectl (BlueZ D-Bus bluetooth operation library)"
    default n

    config BLUECTL_AGENT_ENABLED
        bool "compile pairing agent support"
        default y
        depends on BLUECTL_COMPONENT_ENABLED

    config BLUECTL_MEDIA_ENABLED
        bool "compile media player control (AVRCP) support"
        default n
        depends on BLUECTL_COMPONENT_ENABLED

    config BLUECTL_DYNAMIC
        bool "compile component as dynamic(shared) lib"
        default n
        depends on BLUECTL_COMPONENT_ENABLED
```

## ext_components/cp0_lvgl/Kconfig
```kconfig
menuconfig CP0_LVGL_COMPONENT_ENABLED
    bool "Enable cp0 lvgl support"
    default n

if CP0_LVGL_COMPONENT_ENABLED

config CP0_LVGL_USE_ZMQ_LOG
    bool "Enable cp0 lvgl zmq log publisher"
    default n

config CP0_LVGL_USE_ZMQ_RPC
    bool "Enable cp0 lvgl local ZMQ automation RPC"
    default n

menu "Optional runtime services"

config CP0_LVGL_INIT_FILESYSTEM
    bool "Initialize filesystem service"
    default n
config CP0_LVGL_INIT_CONFIG
    bool "Initialize configuration service"
    default n
config CP0_LVGL_INIT_PTY
    bool "Initialize PTY service"
    default n
config CP0_LVGL_INIT_RPC
    bool "Initialize RPC service"
    default n
config CP0_LVGL_INIT_AUDIO
    bool "Initialize audio service"
    default n
config CP0_LVGL_INIT_PROCESS
    bool "Initialize process service"
    default n
config CP0_LVGL_INIT_SUDO
    bool "Initialize sudo signals"
    default n
config CP0_LVGL_INIT_OSINFO
    bool "Initialize OS information service"
    default n
config CP0_LVGL_INIT_SCREENSHOT
    bool "Initialize screenshot service"
    default n
config CP0_LVGL_INIT_LORA
    bool "Initialize LoRa service"
    default n
config CP0_LVGL_INIT_WIFI
    bool "Initialize Wi-Fi service"
    select CP0_LVGL_INIT_PROCESS
    default n
config CP0_LVGL_INIT_BLUETOOTH
    bool "Initialize Bluetooth service"
    default n
config CP0_LVGL_INIT_SETTINGS
    bool "Initialize settings service"
    default n
config CP0_LVGL_INIT_BQ27220
    bool "Initialize BQ27220 service"
    default n
config CP0_LVGL_INIT_SAVED_SETTINGS
    bool "Apply saved LVGL settings"
    default n
config CP0_LVGL_INIT_BATTERY
    bool "Initialize battery service"
    default n
config CP0_LVGL_INIT_CAMERA
    bool "Initialize camera service"
    default n
config CP0_LVGL_INIT_SOUNDCARD
    bool "Initialize sound card service"
    default n

endmenu

endif
```

## ext_components/nmtui/Kconfig
```kconfig
menuconfig NMTUI_COMPONENT_ENABLED
    bool "Enable nmtui libnm Wi-Fi signal adapter"
    default n
    depends on CP0_LVGL_COMPONENT_ENABLED
    select CP0_LVGL_INIT_WIFI

if NMTUI_COMPONENT_ENABLED

config NMTUI_DYNAMIC
    bool "compile nmtui component as dynamic(shared) lib"
    default n

endif
```

## projects/APPLaunch/main/Kconfig
```kconfig
# SPDX-FileCopyrightText: 2026 M5Stack Technology CO LTD
#
# SPDX-License-Identifier: MIT

menu "APPLaunch"

config APPLAUNCH_CROSS
    bool "cross compile"
    default y if APPLAUNCH_LINUX_X86_CROSS_CP0
    default y if APPLAUNCH_WIN_X86_CROSS_CP0
    default y if APPLAUNCH_MAC_CROSS_CP0

choice APPLAUNCH_BUILD_TARGET
    prompt "APPLaunch build target"
    default APPLAUNCH_LINUX_X86_SDL2

config APPLAUNCH_LINUX_X86_SDL2
    bool "Linux x86 SDL2"

config APPLAUNCH_LINUX_X86_CROSS_CP0
    bool "Linux x86 cross CP0"

config APPLAUNCH_WIN_X86_SDL2
    bool "Windows x86 SDL2"

config APPLAUNCH_WIN_X86_CROSS_CP0
    bool "Windows x86 cross CP0"

config APPLAUNCH_LINUX_CP0
    bool "Linux CP0"

config APPLAUNCH_MAC_CROSS_CP0
    bool "macOS cross CP0"

config APPLAUNCH_DARWIN_SDL
    bool "Darwin SDL"

endchoice

# Product builds may inspect Linux MMC mounts for the SD card. Keep this
# disabled for SDL targets so host storage is never exposed as product media.
config APPLAUNCH_TARGET_SD_MMC_STORAGE
    bool
    depends on APPLAUNCH_LINUX_CP0 || APPLAUNCH_LINUX_X86_CROSS_CP0 || APPLAUNCH_MAC_CROSS_CP0 || APPLAUNCH_WIN_X86_CROSS_CP0
    default y

endmenu
```
